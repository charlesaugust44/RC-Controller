#include <cstdarg>
#include <RF24.h>
#include <Wire.h>
#include <ezBuzzer.h>
#include <Adafruit_GFX.h>
#include <Adafruit_SSD1306.h>
#include "Types.cpp"

#define SELECT_BUTTON    PB12
#define ACTION1_BUTTON   PB9
#define ACTION2_BUTTON   PB8
#define ACTION3_BUTTON   PB4
#define ACTION4_BUTTON   PA15
#define ENCODER_CLK      PB14
#define ENCODER_DATA     PB13
#define LEFT_TRIGGER_UP  PC14
#define LEFT_TRIGGER_DW  PB15
#define RIGHT_TRIGGER_UP PC13
#define RIGHT_TRIGGER_DW PA8
#define BUZZER           PA2
#define RIGHT_JOY_BUTTON PC15
#define RIGHT_JOY_X      PA1
#define RIGHT_JOY_Y      PA0
#define LEFT_JOY_BUTTON  PB10
#define LEFT_JOY_X       PA3
#define LEFT_JOY_Y       PA4
#define CS               PB11
#define CE               PB0
#define BATT_VOLTAGE     PB1

#define LOGO_WIDTH  116
#define LOGO_HEIGHT 40

#define HOME          0
#define MENU_OPTIONS  1
#define MENU_LIMIT    2
#define MENU_CURVE    3
#define MENU_MODE     4

#define CURVE_INCREMENT 0.1
#define K_CURVE_MIN     -1.0
#define K_CURVE_MAX     1.0
#define THROW_INCREMENT 2
#define THROW_MIN       0
#define THROW_MAX       80
#define CON_BAT_MAX     8.4
#define CON_BAT_MIN     6.4
#define CON_BAT_TRH     6.6
#define AIR_BAT_MAX     12.6
#define AIR_BAT_MIN     10.5
#define AIR_BAT_TRH     10.6
#define CONFIG_ADDR     0x10

#define ADC_MAX       4095
//#define BENCHMARK
//#define NO_BATTERY
//#define NO_BUZZER

//--------------------------------------------------------------------------------------------------
static const unsigned char PROGMEM logo[] = {0x00, 0xf8, 0x00, 0x00, 0x00, 0x00, 0x00, 0x00, 0x00, 0x00, 0x00, 0x00, 0x00,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 0x00, 0x00};

TransmitPacket transmit;
ReceivePacket  received;

Buttons  buttons, buttonsOld;
Joystick joystick, joystickOld;
Config   config;

uint16_t      pps, packets;
unsigned long last_received, last_pps, last_pps_warning, last_pps_error;
const byte    ac_address[5] = {0xAA, 0xBB, 0xCC, 0xDD, 0xDD};
const byte    ct_address[5] = {0x00, 0xBB, 0xCC, 0xDD, 0xEE};

int16_t last_roll      = 256,
        last_pitch     = 256;
uint8_t menu           = 0,
        selectedOption = 0;
bool    refresh        = false,
        upper          = true,
        rx_inverted    = false,
        ry_inverted    = false,
        lx_inverted    = false,
        pps_warning    = false,
        pps_error      = false;
float   con_v;

RF24 radio(CE, CS);
Adafruit_SSD1306 display;
ezBuzzer buzzer(BUZZER);

#ifdef BENCHMARK
unsigned long l1, l2, l3, l4;
#endif


//--------------------------------------------------------------------------------------------------

void setup() {
  Serial.begin(115200);
  
  padInit();
  screenInit();
  radioInit();

  startup_tone();
}

//--------------------------------------------------------------------------------------------------

void loop() {
#ifdef BENCHMARK
  l1 = millis();
#endif
  screenUpdate();

#ifdef BENCHMARK
  l2 = millis();
#endif
  padSample();

#ifdef BENCHMARK
  l3 = millis();
#endif
  display.display();

#ifdef BENCHMARK
  l4 = millis();
#endif
  radioReceive();
  radioTransmit();

  con_v = analogRead(BATT_VOLTAGE) * 9.9 / ADC_MAX;

#ifndef NO_BUZZER
  buzzer.loop();
#endif

#ifdef BENCHMARK
  log("dddd", (int)(l2 - l1), (int)(l3 - l2), (int)(l4 - l3), (int)(millis() - l4));
#endif

}

//--------------------------------------------------------------------------------------------------

void checkStatus() {
  if (received.bat / 100.0 < AIR_BAT_TRH && received.bat > 600)
    ac_battLow_tone();

  if (con_v < CON_BAT_TRH)
    ct_battLow_tone();

  if ((pps < 55 || received.pps < 55) && millis() - last_pps_warning > 1500) {
    if (pps_warning)
      wr_packetsLow_tone();
    else
      pps_warning = true;
  }
  else
    pps_warning = false;

  if ((pps < 40 || received.pps < 40) && millis() - last_pps_error > 1000) {
    if (pps_error)
      er_packetsLow_tone();
    else
      pps_error = true;
  }
  else
    pps_error = false;

}

//--------------------------------------------------------------------------------------------------

void log(const char* format, ...) {
  va_list args;
  va_start(args, format);

  while (*format != '\0') {
    int    d;
    char   c;
    float  f;
    String s;

    switch (*format) {
      case 'd':
        d = va_arg(args, int);
        Serial.print(d);
        break;
      case 'c':
        c = va_arg(args, char);
        Serial.print(c);
        break;
      case 'f':
        f = va_arg(args, double);
        Serial.print(f);
        break;
      case 's':
        do {
          s = va_arg(args, char);
          Serial.print(s);
        } while (s != '\0');
        break;
    }
    Serial.print(" ");
    format++;
  }
  Serial.println();
  va_end(args);
}

//--------------------------------------------------------------------------------------------------
